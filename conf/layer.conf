## conf/layer.conf
```bitbake
# We have a conf and classes directory, add to BBPATH
BBPATH .= ":${LAYERDIR}"

# We have recipes-* directories, add to BBFILES
BBFILES += "${LAYERDIR}/recipes-*/*/*.bb \
            ${LAYERDIR}/recipes-*/*/*.bbappend"

BBFILE_COLLECTIONS += "meta-can-tester"
BBFILE_PATTERN_meta-can-tester = "^${LAYERDIR}/"
BBFILE_PRIORITY_meta-can-tester = "6"

LAYERDEPENDS_meta-can-tester = "core"
LAYERSERIES_COMPAT_meta-can-tester = "kirkstone"
```
